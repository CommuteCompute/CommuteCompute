/**
 * Text Renderer for CCFirm™ — BMP-based text rendering
 * Part of the Commute Compute System™
 *
 * WORKAROUND: bb_epaper's built-in text functions (setFont/print/drawString)
 * crash on ESP32-C3 in bufferless mode (no allocBuffer). This renderer
 * creates tiny BMP images for each text line and uses loadBMP() which works.
 *
 * See DEVELOPMENT-RULES.md Section 5.4 and firmware/archive/main-v7.cpp
 * which documented: "SKIP boot screen - bb_epaper text drawing crashes on ESP32-C3"
 *
 * Copyright (c) 2026 Angus Bergman
 * SPDX-License-Identifier: AGPL-3.0-or-later
 * Dual-licensed under AGPL-3.0 and commercial terms — see LICENSE
 */

#ifndef TEXT_RENDERER_H
#define TEXT_RENDERER_H

#include <Arduino.h>
#include <bb_epaper.h>

// 8x8 font data — 7 bytes per character, 96 chars (space=32 through DEL=127)
// Column-major: each byte = one column, bit 0 (LSB) = top pixel
// Copied from bb_epaper ucFont (static in library, not accessible externally)
static const uint8_t ccFont[] PROGMEM = {
    0x00,0x00,0x00,0x00,0x00,0x00,0x00,0x00,0x00,0x06,0x5f,0x5f,0x06,0x00,
    0x00,0x07,0x07,0x00,0x07,0x07,0x00,0x14,0x7f,0x7f,0x14,0x7f,0x7f,0x14,
    0x24,0x2e,0x2a,0x6b,0x6b,0x3a,0x12,0x46,0x66,0x30,0x18,0x0c,0x66,0x62,
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    0x02,0x03,0x01,0x03,0x02,0x03,0x01,0x70,0x78,0x4c,0x46,0x4c,0x78,0x70
};

/**
 * Render a text string as a 1-bit BMP and display it using loadBMP().
 *
 * This bypasses bb_epaper's broken text rendering on ESP32-C3 by creating
 * a BMP image containing the rendered text and using the working loadBMP()
 * function to display it.
 *
 * @param epd   Pointer to BBEPAPER instance
 * @param text  Null-terminated string to render (max 60 chars)
 * @param x     X pixel position on display (any alignment)
 * @param y     Y pixel position on display
 * @return      true if rendered successfully
 */
static bool drawTextBmp(BBEPAPER* epd, const char* text, int x, int y) {
    int len = strlen(text);
    if (len == 0 || len > 60 || !epd) return false;

    int pixW = len * 8;
    int rowBytes = ((pixW + 31) / 32) * 4;  // BMP rows are DWORD-aligned
    int dataSize = rowBytes * 8;             // 8 pixel rows
    int bmpSize = 62 + dataSize;             // 62-byte header + pixel data

    uint8_t* bmp = (uint8_t*)malloc(bmpSize);
    if (!bmp) return false;

    // Zero headers, white background for pixel data
    memset(bmp, 0, 62);
    memset(bmp + 62, 0xFF, dataSize);  // all white (bit 1 = white on e-ink)

    // ---- BMP File Header (14 bytes) ----
    bmp[0] = 'B'; bmp[1] = 'M';
    bmp[2] = bmpSize & 0xFF;
    bmp[3] = (bmpSize >> 8) & 0xFF;
    bmp[10] = 62;  // pixel data offset

    // ---- DIB Header (40 bytes) ----
    bmp[14] = 40;  // header size
    bmp[18] = pixW & 0xFF;
    bmp[19] = (pixW >> 8) & 0xFF;
    // Height = -8 (top-down BMP, rows in natural order)
    bmp[22] = 0xF8;  // -8 as int32_t little-endian
    bmp[23] = 0xFF;
    bmp[24] = 0xFF;
    bmp[25] = 0xFF;
    bmp[26] = 1;   // color planes
    bmp[28] = 1;   // bits per pixel

    // ---- Color Table (8 bytes) ----
    // Index 0: black (0x00, 0x00, 0x00, 0x00) — at offset 54
    // Index 1: white (0xFF, 0xFF, 0xFF, 0x00) — at offset 58
    bmp[58] = 0xFF; bmp[59] = 0xFF; bmp[60] = 0xFF;

    // ---- Render text into pixel data ----
    uint8_t* pixels = bmp + 62;

    for (int ci = 0; ci < len; ci++) {
        int ch = (unsigned char)text[ci];
        if (ch < 32 || ch > 127) ch = 32;  // default to space

        // Get font column data (7 bytes from font + 1 blank leading column)
        int fontIdx = (ch - 32) * 7;
        uint8_t cols[8];
        cols[0] = 0;  // blank leading column (matches bb_epaper convention)
        memcpy_P(&cols[1], &ccFont[fontIdx], 7);

        // For each pixel row (0=top, 7=bottom)
        for (int row = 0; row < 8; row++) {
            uint8_t rowMask = 1 << row;  // font is column-major, bit 0 = top

            // For each column of this character
            for (int col = 0; col < 8; col++) {
                if (cols[col] & rowMask) {
                    // Font pixel present → clear BMP bit (0 = black on e-ink)
                    int pixelX = ci * 8 + col;
                    int byteIdx = pixelX / 8;
                    int bitIdx = 7 - (pixelX % 8);  // MSB = leftmost pixel
                    pixels[row * rowBytes + byteIdx] &= ~(1 << bitIdx);
                }
            }
        }
    }

    int result = epd->loadBMP(bmp, x, y, BBEP_BLACK, BBEP_WHITE);
    free(bmp);
    return (result == 0);
}

/**
 * Render centered text on the display.
 *
 * @param epd       Pointer to BBEPAPER instance
 * @param text      Null-terminated string
 * @param screenW   Screen width in pixels (for centering)
 * @param y         Y pixel position
 * @return          true if rendered successfully
 */
static bool drawTextCentered(BBEPAPER* epd, const char* text, int screenW, int y) {
    int len = strlen(text);
    int textW = len * 8;
    int x = (screenW - textW) / 2;
    if (x < 0) x = 0;
    return drawTextBmp(epd, text, x, y);
}

#endif // TEXT_RENDERER_H
